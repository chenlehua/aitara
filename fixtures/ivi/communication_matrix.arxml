AUTOSAR XML (schema 00049)
package /IVI_System  # In-Vehicle Infotainment System Communication Matrix
package /IVI_System/EcuInstances
  7 x ecu instance:
    IVI_HeadUnit  # IVI Head Unit ECU
    Gateway  # Central Gateway ECU
    BCM  # Body Control Module
    HVAC  # HVAC Controller
    Amplifier  # Audio Amplifier
    Cluster  # Instrument Cluster
    TPMS  # Tire Pressure Monitoring System
package /IVI_System/CommunicationClusters
  can cluster BodyCAN: baudrate=500000, protocol-name=CAN, protocol-version=2.0B  # Body Domain CAN Network
    can physical channel BodyCAN_Channel: comm-connectors=[CAN_Connector, CAN_Connector, CAN_Connector]
package /IVI_System/IPduGroups
  i pdu group VehicleStatus_PduGroup: communication-direction=IN, i-pdu-group=[VehicleSpeed_Pdu, EngineRPM_Pdu, FuelLevel_Pdu, GearPosition_Pdu]
  i pdu group BodyControl_PduGroup: communication-direction=IN, i-pdu-group=[DoorStatus_Pdu, SeatbeltStatus_Pdu, LightStatus_Pdu]
  i pdu group RemoteControl_PduGroup: communication-direction=OUT, i-pdu-group=[RemoteDoorLock_Pdu, RemoteDoorUnlock_Pdu, RemoteEngineStart_Pdu]
package /IVI_System/IPdus
  pdu VehicleSpeed_Pdu: length=2, transmission-mode-condition=transmission-mode-true-timing=cyclic-timing=time-period=0.1
    signal VehicleSpeed: start 0, 16 bit, little-endian, i-signal-type=PRIMITIVE, init-value=0, compu {phys=raw*0.01}, unit=km/h  # Vehicle Speed
  pdu EngineRPM_Pdu: length=2, transmission-mode-condition=transmission-mode-true-timing=cyclic-timing=time-period=0.05
    signal EngineRPM: start 0, 16 bit, little-endian, i-signal-type=PRIMITIVE, compu {phys=raw*0.25}, unit=RPM  # Engine Rotation Speed
  pdu FuelLevel_Pdu: length=1, transmission-mode-condition=transmission-mode-true-timing=cyclic-timing=time-period=1.0
  pdu GearPosition_Pdu: length=1, transmission-mode-condition
  pdu DoorStatus_Pdu: length=1, transmission-mode-condition
  pdu SeatbeltStatus_Pdu: length=1
  pdu LightStatus_Pdu: length=2
  pdu RemoteDoorLock_Pdu: length=2, transmission-mode-condition
  pdu RemoteDoorUnlock_Pdu: length=2, transmission-mode-condition
  pdu RemoteEngineStart_Pdu: length=4
  pdu DiagRequest_Pdu: length=8
  pdu DiagResponse_Pdu: length=8
package /IVI_System/Units
  4 x unit:
    kmh: display-name=km/h  # Kilometers per Hour
    rpm: display-name=RPM  # Revolutions per Minute
    percent: display-name=%  # Percentage
    kPa: display-name=kPa  # Kilopascal
package /IVI_System/FrameTriggerings
  frame VehicleSpeed_FrameTrig: id 0x123
  frame EngineRPM_FrameTrig: id 0x124
  frame FuelLevel_FrameTrig: id 0x125
  frame GearPosition_FrameTrig: id 0x126
  frame DoorStatus_FrameTrig: id 0x200
  frame SeatbeltStatus_FrameTrig: id 0x201
  frame RemoteDoorLock_FrameTrig: id 0x500
  frame RemoteDoorUnlock_FrameTrig: id 0x501
  frame RemoteEngineStart_FrameTrig: id 0x502
  frame DiagRequest_FrameTrig: id 0x7DF
  frame DiagResponse_FrameTrig: id 0x7E8
